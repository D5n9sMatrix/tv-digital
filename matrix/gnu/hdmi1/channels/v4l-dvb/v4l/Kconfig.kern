## matrix/gnu/hdmi1/channels/v4l-dvb/v4l/Kconfig.kern
```kconfig
# Needed by SOC_CAMERA_MT9V022, SOC_CAMERA_MT9M001
config GPIO_PCA953X
	tristate
	default m

# Needed by VIDEO_TM6000_ALSA, VIDEO_TLG2300, VIDEO_CX25821_ALSA, VIDEO_CX88_ALSA, VIDEO_CX231XX_ALSA, SND_BT87X, VIDEO_CX18_ALSA, RADIO_MIROPCM20, VIDEO_GO7007, VIDEO_SAA7134_ALSA, VIDEO_EM28XX_ALSA
config SND
	tristate
	default m

# Needed by RADIO_MIROPCM20
config SND_MIRO
	tristate
	default n

# Needed by RADIO_MIROPCM20
config SND_ISA
	tristate
	default n

# Needed by always, MEDIA_ATTACH
config MODULES
	tristate
	default y

# Needed by VIDEO_VINO
config SGI_IP22
	tristate
	default n

# Needed by VIDEO_MX3
config MX3_IPU
	tristate
	default n

# Needed by SOC_CAMERA, VIDEOBUF_DMA_CONTIG, VIDEOBUF_DMA_SG, VIDEO_SH_MOBILE_CEU, SMS_SIANO_MDTV
config HAS_DMA
	tristate
	default y

# Needed by VIDEO_OMAP2_VOUT
config OMAP2_VRAM
	tristate
	default n

# Needed by VIDEO_VIVI
config FRAMEBUFFER_CONSOLE
	tristate
	default y

# Needed by USB_GSPCA_SPCA506, USB_GSPCA_SPCA500, VIDEO_HDPVR, VIDEO_EM28XX, USB_GSPCA_SPCA561, USB_DABUSB, USB_GSPCA_SPCA505, USB_STKWEBCAM, VIDEO_CPIA_USB, USB_SE401, DVB_B2C2_FLEXCOP_USB, VIDEO_PVRUSB2_DVB, USB_GSPCA_OV534, VIDEO_GO7007_USB, USB_GSPCA_MR97310A, USB_SN9C102, USB_GSPCA_SN9C2028, USB_GSPCA_PAC7311, USB_GSPCA_SPCA508, USB_GSPCA_SPCA1528, VIDEO_TM6000, USB_GSPCA_SPCA501, USB_GSPCA_PAC7302, VIDEO_CX231XX_DVB, USB_VICAM, DVB_TTUSB_BUDGET, VIDEO_CPIA2, V4L_USB_DRIVERS, USB_GL860, SMS_USB_DRV, VIDEO_EM28XX_ALSA, USB_ZR364XX, USB_GSPCA_CPIA1, IR_MCEUSB, IR_IMON, USB_GSPCA_SN9C20X, USB_IBMCAM, USB_GSPCA_CONEX, USB_GSPCA_PAC207, USB_GSPCA, VIDEO_USBVIDEO, USB_GSPCA_STV0680, USB_GSPCA_SONIXJ, USB_GSPCA_SQ905C, VIDEO_PVRUSB2_DEBUGIFC, USB_GSPCA_OV534_9, USB_GSPCA_FINEPIX, USB_GSPCA_TV8532, USB_GSPCA_ETOMS, USB_VIDEO_CLASS, USB_VIDEO_CLASS_INPUT_EVDEV, USB_ET61X251, USB_KONICAWC, USB_GSPCA_JEILINJ, USB_S2255, USB_PWC_DEBUG, VIDEO_TLG2300, USB_SI470X, USB_M5602, USB_GSPCA_STK014, VIDEO_USBVISION, VIDEO_EM28XX_DVB, USB_GSPCA_OV519, USB_GSPCA_SQ930X, VIDEO_CX231XX, USB_PWC, USB_GSPCA_ZC3XX, USB_DSBR, USB_GSPCA_SONIXB, USB_GSPCA_T613, USB_STV06XX, VIDEO_AU0828, USB_GSPCA_SUNPLUS, DVB_USB, VIDEO_PVRUSB2, USB_GSPCA_VC032X, USB_PWC_INPUT_EVDEV, USB_GSPCA_MARS, DVB_TTUSB_DEC, USB_GSPCA_SQ905, USB_GSPCA_BENQ, VIDEO_TM6000_DVB, USB_MR800, VIDEO_CX231XX_ALSA, VIDEO_PVRUSB2_SYSFS
config USB
	tristate
	default y

# Needed by VIDEO_FB_IVTV
config FB_CFB_FILLRECT
	tristate
	default y

# Needed by VIDEO_SAA7134, DVB_TTUSB_DEC, DVB_CORE, VIDEO_GO7007
config CRC32
	tristate
	default y

# Needed by RADIO_RTRACK, RADIO_AZTECH, RADIO_GEMTEK, RADIO_SF16FMI, RADIO_TYPHOON, RADIO_MIROPCM20, RADIO_SF16FMR2, VIDEO_PMS, RADIO_TRUST, RADIO_RTRACK2, RADIO_ZOLTRIX, RADIO_CADET, RADIO_TERRATEC
config ISA
	tristate
	default n

# Needed by VIDEO_SH_MOBILE_CEU
config HAVE_CLK
	tristate
	default y

# Needed by VIDEO_M32R_AR_M64278
config PLAT_M32700UT
	tristate
	default n

# Needed by VIDEO_VIVI
config SPARC32
	tristate
	default n

# Needed by SOC_CAMERA_MT9M001
config MT9M001_PCA9536_SWITCH
	tristate
	default n

# Needed by IR_IMON, IR_MCEUSB
config USB_ARCH_HAS_HCD
	tristate
	default y

# Needed by VIDEO_TLV320AIC23B, VIDEO_VINO, DVB_USB_EC168, VIDEO_STRADIS, VIDEO_CX18, VIDEO_PVRUSB2_DVB, VIDEO_TM6000, VIDEO_CX25821_ALSA, VIDEO_PVRUSB2_SYSFS, USB_VICAM, VIDEO_TM6000_DVB, MEDIA_TUNER_TEA5761, VIDEO_TM6000_ALSA, VIDEO_CQCAM, VIDEO_CX18_ALSA, VIDEO_CX88_ALSA, DVB_USB_AF9005, USB_STKWEBCAM, DVB_USB_CE6230, VIDEO_ZORAN_AVS6EYES
config EXPERIMENTAL
	tristate
	default n

# Needed by DVB_FIREDTV
config FIREWIRE
	tristate
	default m

# Needed by VIDEO_VPFE_CAPTURE
config ARCH_OMAP3
	tristate
	default n

# Needed by VIDEO_OMAP2_VOUT
config ARCH_OMAP34XX
	tristate
	default n

# Needed by VIDEO_CPIA_PP, VIDEO_W9966
config PARPORT_1284
	tristate
	default y

# Needed by VIDEO_OMAP2_VOUT
config OMAP2_DSS
	tristate
	default n

# Needed by DVB_FIREDTV
config IEEE1394
	tristate
	default n

# Needed by VIDEO_PXA27x
config PXA27x
	tristate
	default n

# Needed by VIDEO_CQCAM, VIDEO_W9966, VIDEO_CPIA_PP, VIDEO_BWQCAM
config PARPORT
	tristate
	default m

# Needed by VIDEO_FB_IVTV
config FB_CFB_COPYAREA
	tristate
	default y

# Needed by VIDEO_FB_IVTV
config FB
	tristate
	default y

# Needed by VIDEO_SAA7164
config FW_LOADER
	tristate
	default y

# Needed by DVB_BUDGET_CORE, DVB_B2C2_FLEXCOP_PCI, VIDEO_CX18, DVB_MANTIS, VIDEO_CX23885, DVB_PT1, VIDEO_HEXIUM_GEMINI, RADIO_MAXIRADIO, VIDEO_MEYE, VIDEO_GO7007, DVB_AV7110, RADIO_MAESTRO, VIDEO_CAFE_CCIC, VIDEO_SAA7164, DVB_TTUSB_DEC, RADIO_GEMTEK_PCI, VIDEO_MXB, VIDEO_BTCX, VIDEO_STRADIS, VIDEO_IVTV, DVB_NGENE, VIDEO_CX88, DVB_PLUTO2, VIDEO_HEXIUM_ORION, DVB_HOPPER, DVB_DM1105, MANTIS_CORE, VIDEO_CX25821, SND_BT87X, VIDEO_SAA7146, DVB_TTUSB_BUDGET, VIDEO_BT848, VIDEO_SAA7134, DVB_BT8XX, VIDEO_ZORAN
config PCI
	tristate
	default y

# Needed by VIDEO_FB_IVTV
config FB_CFB_IMAGEBLIT
	tristate
	default y

# Needed by VIDEO_SH_VOU
config ARCH_SHMOBILE
	tristate
	default n

# Needed by VIDEO_VIVI
config FONTS
	tristate
	default y

# Needed by VIDEO_ISIF
config ARCH_DAVINCI_DM365
	tristate
	default n

# Needed by DVB_CORE
config NET
	tristate
	default y

# Needed by VIDEO_SAA7164, VIDEO_BT848, VIDEO_CX18, VIDEO_CX25821, VIDEO_IVTV, VIDEO_CX23885, DVB_PLUTO2, VIDEO_CX88, VIDEO_ZORAN, VIDEO_AU0828
config I2C_ALGOBIT
	tristate
	default m

# Needed by VIDEO_VIVI
config STI_CONSOLE
	tristate
	default n

# Needed by DVB_CORE
config INET
	tristate
	default y

# Needed by VIDEO_TM6000_ALSA, VIDEO_TLG2300, VIDEO_CX25821_ALSA, VIDEO_CX88_ALSA, VIDEO_CX231XX_ALSA, SND_BT87X, VIDEO_CX18_ALSA, VIDEO_GO7007, VIDEO_SAA7134_ALSA, VIDEO_EM28XX_ALSA
config SND_PCM
	tristate
	default m

# Needed by VIDEO_PVRUSB2_SYSFS
config SYSFS
	tristate
	default y

# Needed by VIDEO_OMAP2_VOUT
config OMAP2_VRFB
	tristate
	default n

# Needed by SOC_CAMERA_MT9M001, VIDEO_MSP3400, VIDEO_CAFE_CCIC, VIDEO_TEA6415C, DVB_CX24123, DVB_NXT200X, DVB_STV6110x, DVB_B2C2_FLEXCOP_PCI, VIDEO_CX18, VIDEO_TVP514X, MEDIA_TUNER_MXL5007T, DVB_DIB3000MC, DVB_TDA10048, VIDEO_SAA7146, MEDIA_TUNER_MT2060, DVB_PLL, VIDEO_OV7670, I2C_SI4713, VIDEO_VINO, VIDEO_MXB, DVB_L64781, VIDEO_SAA7164, VIDEO_TLV320AIC23B, DVB_DM1105, DVB_LGDT3305, VIDEO_SAA6588, VIDEO_CX88, DVB_S5H1409, MEDIA_TUNER_MT20XX, DVB_BUDGET_AV, DVB_STV6110, DVB_MT352, DVB_ATBM8830, VIDEO_UPD64083, SOC_CAMERA_MT9T031, MEDIA_TUNER_TDA9887, DVB_TUNER_DIB0090, DVB_TDA10086, VIDEO_AU0828, RADIO_SAA7706H, VIDEO_M52790, MEDIA_TUNER_TDA18271, VIDEO_ADV7170, DVB_VES1X93, DVB_HOPPER, MEDIA_TUNER_MAX2165, VIDEO_SAA711X, SOC_CAMERA_MT9M111, DVB_TUNER_DIB0070, TTPCI_EEPROM, DVB_TDA10023, DVB_B2C2_FLEXCOP_USB, VIDEO_TDA9875, DVB_VES1820, DVB_BUDGET_CORE, DVB_STV0288, DVB_LGDT3304, DVB_TTUSB_BUDGET, VIDEO_ADV7175, RADIO_TIMBERDALE, VIDEO_WM8739, DVB_ISL6423, DVB_ISL6405, VIDEO_VPX3220, VIDEO_CS53L32A, DVB_TUA6100, DVB_STV0900, DVB_ISL6421, VIDEO_TVP7002, DVB_NXT6000, VIDEO_BT866, DVB_LGS8GL5, DVB_ZL10039, VIDEO_AK881X, SOC_CAMERA_TW9910, DVB_STB0899, DVB_MANTIS, VIDEO_BT819, MEDIA_TUNER_QT1010, DVB_TDA8083, MEDIA_TUNER_TDA8290, DVB_TDA665x, DVB_TUNER_ITD1000, VIDEO_USBVISION, DVB_CX24110, DVB_DIB7000M, VIDEO_PVRUSB2, DVB_TDA826X, DVB_BUDGET, DVB_B2C2_FLEXCOP, DVB_STB6100, SOC_CAMERA_MT9V022, DVB_PLUTO2, VIDEO_THS7303, VIDEO_EM28XX, SOC_CAMERA_MT9T112, VIDEO_V4L2_COMMON, VIDEO_VP27SMPX, DVB_TDA8261, DVB_CX24116, DVB_EC100, DVB_ZL10353, DVB_OR51132, VIDEO_TDA7432, VIDEO_CS5345, MEDIA_TUNER_MXL5005S, DVB_DS3000, DVB_DIB7000P, DVB_SP8870, DVB_DIB8000, DVB_BUDGET_CI, MEDIA_TUNER_XC5000, DVB_BUDGET_PATCH, MEDIA_TUNER_TDA827X, RADIO_SI4713, DVB_STV090x, DVB_DRX397XD, MEDIA_TUNER_TEA5761, DVB_AF9013, VIDEO_SAA5249, DVB_BCM3510, DVB_STB6000, SOC_CAMERA_RJ54N1, DVB_TDA10021, VIDEO_TDA9840, VIDEO_TLG2300, VIDEO_HEXIUM_GEMINI, DVB_PT1, VIDEO_SAA7127, VIDEO_CX23885, MEDIA_TUNER_SIMPLE, VIDEO_TVEEPROM, DVB_TUNER_CX24113, DVB_CX22702, VIDEO_CX25821, MANTIS_CORE, SOC_CAMERA_OV772X, DVB_AU8522, MEDIA_TUNER_MT2131, VIDEO_HEXIUM_ORION, VIDEO_TEA6420, DVB_S5H1420, DVB_MT312, SOC_CAMERA, DVB_AV7110, I2C_SI470X, DVB_S921, VIDEO_CX25840, VIDEO_TVP5150, DVB_S5H1411, MEDIA_TUNER, VIDEO_KS0127, VIDEO_SAA7110, DVB_ZL10036, VIDEO_TM6000, DVB_STV0297, DVB_SI21XX, DVB_BT8XX, VIDEO_IVTV, DVB_CX22700, RADIO_TEA5764, MEDIA_TUNER_TEA5767, MEDIA_TUNER_XC2028, DVB_LNBP21, VIDEO_BT856, VIDEO_TCM825X, SOC_CAMERA_OV9640, VIDEO_SAA717X, DVB_LGS8GXX, VIDEO_WM8775, VIDEO_UPD64031A, MEDIA_TUNER_MT2266, VIDEO_GO7007, VIDEO_ADV7343, VIDEO_SAA5246A, VIDEO_MT9V011, DVB_DIB3000MB, VIDEO_TVAUDIO, VIDEO_SAA7191, DVB_SP887X, VIDEO_BT848, VIDEO_CX231XX, MEDIA_TUNER_MC44S803, DVB_LGDT330X, DVB_STV0299, VIDEO_SAA7134, DVB_USB, DVB_NGENE, RADIO_TEF6862, DVB_TDA1004X, VIDEO_ADV7180, DVB_MB86A16, VIDEO_IR_I2C, VIDEO_SAA7185, DVB_OR51211
config I2C
	tristate
	default y

# Needed by VIDEO_ZORAN, VIDEO_STRADIS
config VIRT_TO_BUS
	tristate
	default n

# Needed by IR_RC5_DECODER, IR_NEC_DECODER
config BITREVERSE
	tristate
	default y

# Needed by VIDEO_MX1
config ARCH_MX1
	tristate
	default n

# Needed by VIDEO_MEYE
config SONY_LAPTOP
	tristate
	default m

# Needed by VIDEO_MX1
config FIQ
	tristate
	default n

# Needed by VIDEO_VIVI
config FONT_8x16
	tristate
	default y

# Needed by VIDEO_DM355_CCDC
config ARCH_DAVINCI_DM355
	tristate
	default n

# Needed by SND_FM801_TEA575X
config SND_FM801
	tristate
	default m

# Needed by RADIO_TIMBERDALE
config MFD_TIMBERDALE
	tristate
	default n

# Needed by DVB_DM1105, VIDEO_CX88, VIDEO_IVTV, USB_PWC_INPUT_EVDEV, DVB_TTUSB_DEC, VIDEO_SAA7134, IR_CORE, VIDEO_AU0828, DVB_USB, DVB_BUDGET_CI, VIDEO_CX25821, VIDEO_BT848, VIDEO_CX231XX, MANTIS_CORE, VIDEO_TLG2300, VIDEO_TM6000, VIDEO_CX23885, VIDEO_CX18, SMS_SIANO_MDTV, USB_VIDEO_CLASS_INPUT_EVDEV, VIDEO_EM28XX, VIDEO_GO7007
config INPUT
	tristate
	default y

# Needed by SOC_CAMERA_MT9V022
config MT9V022_PCA9536_SWITCH
	tristate
	default n

# Needed by VIDEO_M32R_AR
config M32R
	tristate
	default n

# Needed by MEDIA_SUPPORT
config HAS_IOMEM
	tristate
	default y

# Needed by VIDEO_OMAP2
config ARCH_OMAP2
	tristate
	default n

# Needed by DISPLAY_DAVINCI_DM646X_EVM, CAPTURE_DAVINCI_DM646X_EVM
config MACH_DAVINCI_DM6467_EVM
	tristate
	default n

# Needed by VIDEO_VIVI
config SPARC64
	tristate
	default n

# Needed by VIDEO_VPSS_SYSTEM, VIDEO_VPFE_CAPTURE
config ARCH_DAVINCI
	tristate
	default n

# Needed by SMS_SDIO_DRV
config MMC
	tristate
	default y

# Needed by VIDEO_OMAP2_VOUT
config ARCH_OMAP24XX
	tristate
	default n
```
